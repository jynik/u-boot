## board/emcraft/imx6ull_som/Kconfig
```kconfig
if TARGET_EMCRAFT_IMX6ULL_SOM

config IMX_CONFIG
	default "board/emcraft/imx6ull_som/imximage.cfg"

config SYS_BOARD
	default "imx6ull_som"

config SYS_VENDOR
	default "emcraft"

config SYS_CONFIG_NAME
	default "imx6ull_som"

endif
```

## configs/imx6ull_som_defconfig
```kconfig
CONFIG_ARM=y
CONFIG_ARCH_MX6=y
CONFIG_MX6ULL=y
CONFIG_SYS_TEXT_BASE=0x87800000
CONFIG_SYS_MEMTEST_START=0x80000000
CONFIG_SYS_MEMTEST_END=0x88000000
CONFIG_TARGET_EMCRAFT_IMX6ULL_SOM=y
CONFIG_DEFAULT_DEVICE_TREE="imx6ull-som"
CONFIG_APBH_DMA=y
CONFIG_APBH_DMA_BURST=y
CONFIG_APBH_DMA_BURST8=y
CONFIG_ENV_VARS_UBOOT_RUNTIME_CONFIG=y
CONFIG_ENV_SIZE=0x10000
CONFIG_ENV_OFFSET=0x60000
CONFIG_NR_DRAM_BANKS=1
CONFIG_ENV_IS_IN_NAND=y
CONFIG_SYS_PROMPT="IMX6ULL-SOM U-Boot > "
CONFIG_DISPLAY_CPUINFO=y
CONFIG_DISPLAY_BOARDINFO=y
CONFIG_BOOTDELAY=3
CONFIG_BOARD_EARLY_INIT_F=y
CONFIG_SPI=y
CONFIG_SOFT_SPI=y
CONFIG_MTD=y
CONFIG_MTD_RAW_NAND=y
CONFIG_NAND_MXS=y
CONFIG_MXC_UART=y
CONFIG_MII=y
CONFIG_FEC_MXC=y
CONFIG_PHYLIB=y
CONFIG_PHY_MICREL=y
CONFIG_IMX_THERMAL=y
CONFIG_IOMUX_LPSR=y
CONFIG_HUSH_PARSER=y
CONFIG_CMD_BOOTZ=y
# CONFIG_CMD_IMLS is not set
CONFIG_CMD_MEMTEST=y
CONFIG_CMD_MMC=y
CONFIG_CMD_MII=y
CONFIG_CMD_I2C=y
CONFIG_CMD_GPIO=y
CONFIG_CMD_DHCP=y
CONFIG_CMD_PING=y
CONFIG_CMD_NET=y
CONFIG_CMD_CACHE=y
CONFIG_CMD_EXT2=y
CONFIG_CMD_EXT4=y
CONFIG_CMD_FAT=y
CONFIG_CMD_FS_GENERIC=y
CONFIG_CMD_TIME=y
CONFIG_CMD_SAVEENV=y
CONFIG_CMD_NAND=y
CONFIG_CMD_FUSE=y
CONFIG_OF_CONTROL=y
CONFIG_BLK=y
CONFIG_DM_GPIO=y
CONFIG_DM_SPI=y
CONFIG_DM_74X164=y
CONFIG_DM_I2C=y
CONFIG_DM_MMC=y
# CONFIG_DM_MMC_OPS is not set
CONFIG_PINCTRL=y
CONFIG_DM_SERIAL=y
CONFIG_PINCTRL_IMX6=y
CONFIG_DM_REGULATOR=y
# CONFIG_EFI_LOADER is not set
# CONFIG_SYS_MALLOC_CLEAR_ON_INIT is not set
```

## configs/imx6ull_som_demo_defconfig
```kconfig
CONFIG_ARM=y
CONFIG_ARCH_MX6=y
CONFIG_MX6ULL=y
CONFIG_SYS_TEXT_BASE=0x87800000
CONFIG_SYS_MEMTEST_START=0x80000000
CONFIG_SYS_MEMTEST_END=0x88000000
CONFIG_TARGET_EMCRAFT_IMX6ULL_SOM=y
CONFIG_DEFAULT_DEVICE_TREE="imx6ull-som"
CONFIG_APBH_DMA=y
CONFIG_APBH_DMA_BURST=y
CONFIG_APBH_DMA_BURST8=y
CONFIG_ENV_VARS_UBOOT_RUNTIME_CONFIG=y
CONFIG_ENV_SIZE=0x10000
CONFIG_ENV_OFFSET=0x60000
CONFIG_NR_DRAM_BANKS=1
CONFIG_ENV_IS_NOWHERE=y
CONFIG_SYS_PROMPT="DEF CON U-Boot > "
CONFIG_DISPLAY_CPUINFO=y
CONFIG_DISPLAY_BOARDINFO=y
CONFIG_BOOTDELAY=3
CONFIG_BOARD_EARLY_INIT_F=y
CONFIG_SPI=y
CONFIG_SOFT_SPI=y
CONFIG_MTD=y
CONFIG_MTD_RAW_NAND=y
CONFIG_NAND_MXS=y
CONFIG_MXC_UART=y
CONFIG_MII=y
CONFIG_FEC_MXC=y
CONFIG_PHYLIB=y
CONFIG_PHY_MICREL=y
CONFIG_IMX_THERMAL=y
CONFIG_IOMUX_LPSR=y
CONFIG_HUSH_PARSER=y
# CONFIG_CMD_IMLS is not set
CONFIG_CMD_NAND=y
CONFIG_OF_CONTROL=y
CONFIG_BLK=y
CONFIG_DM_GPIO=y
CONFIG_DM_SPI=y
CONFIG_DM_74X164=y
CONFIG_DM_I2C=y
CONFIG_DM_MMC=y
# CONFIG_DM_MMC_OPS is not set
CONFIG_PINCTRL=y
CONFIG_DM_SERIAL=y
CONFIG_PINCTRL_IMX6=y
CONFIG_DM_REGULATOR=y
# CONFIG_EFI_LOADER is not set
# CONFIG_SYS_MALLOC_CLEAR_ON_INIT is not set
CONFIG_CMD_RUN=y

# commented out stuff in code for this
CONFIG_CMD_MEMORY=y

# Disable a bunch of commands so we can demo use of crc32 as a memory R/W primitive
# CONFIG_CMD_BLOCK_CACHE is not set
# CONFIG_CMD_FLASH is not set
# CONFIG_CMD_LOADB is not set
# CONFIG_CMD_LOADS is not set
# CONFIG_CMD_SOURCE is not set
# CONFIG_CMD_SETEXPR is not set
# CONFIG_CMD_BDI is not set
# CONFIG_CMD_ELF is not set
# CONFIG_CMD_FDT is not set
# CONFIG_CMD_GO is not set
# CONFIG_CMD_IMI is not set
# CONFIG_CMD_XIMG is not set
# CONFIG_CMD_NFS is not set
# CONFIG_CMD_BMODE is not set
# CONFIG_CMD_ITEST is not set
# CONFIG_CMD_BOOTD is not set
# CONFIG_CMD_BOOT is not set
# CONFIG_CMD_EDITENV is not set
# CONFIG_CMD_SAVENV is not set
# CONFIG_CMD_SETENV is not set
# CONFIG_CMD_NBOOT is not set
# CONFIG_CMD_BOOTP is not set
# CONFIG_CMD_BOOTP is not set
# CONFIG_CMD_TFTPBOOT is not set
# CONFIG_CMD_PINMUX is not set
# CONFIG_CMD_CONSOLE is not set
# CONFIG_CMD_NVEDIT is not set
# CONFIG_CMD_SLEEP is not set
# CONFIG_CMD_ENV is not set


CONFIG_POST=y
CONFIG_CMD_DIAG=y
CONFIG_CMD_CRC32=y
```
